/dts-v1/;
/plugin/;

/*
 * Device Tree Overlay for LS020 Siemens S65 TFT LCD
 * Target: Orange Pi Zero 2W (Allwinner H618)
 * 
 * Pin connections:
 * SPI1_MOSI (PH7) -> LS020 Pin 6 (MOSI)  
 * SPI1_CLK  (PH6) -> LS020 Pin 7 (SCL)
 * SPI1_CS0  (PH5) -> LS020 Pin 8 (CS)
 * PI14             -> LS020 Pin 9 (RST)
 * PH4              -> LS020 Pin 10 (RS/DC)
 * 
 * Power:
 * 3.3V             -> LS020 Pin 5 (+2.9V)
 * GND              -> LS020 Pin 4 (GND)
 */

/ {
    compatible = "allwinner,sun50i-h618";

    fragment@0 {
        target = <&spi1>;
        __overlay__ {
            #address-cells = <1>;
            #size-cells = <0>;
            status = "okay";
            pinctrl-names = "default";
            pinctrl-0 = <&spi1_pins>, <&spi1_cs0_pin>;

            ls020: ls020@0 {
                compatible = "siemens,ls020";
                reg = <0>;
                spi-max-frequency = <32000000>;
                status = "okay";
                
                reset-gpios = <&pio 8 14 0>; /* PI14, active high */
                dc-gpios = <&pio 7 4 0>;    /* PH4, active high */
                
                width = <176>;
                height = <132>;
                bpp = <16>;
                fps = <25>;
            };
        };
    };
};